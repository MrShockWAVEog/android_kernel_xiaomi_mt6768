## drivers/input/touchscreen/mediatek/FT8719/Kconfig
```kconfig
#
# Focaltech Touchscreen driver configuration
#

config TOUCHSCREEN_FT8719
	bool "Focaltech Touchscreen"
	default n
	help
	  Say Y here if you have Focaltech touch panel.
	  If unsure, say N.

config TOUCHSCREEN_FTS_DIRECTORY
	string "Focaltech ts directory name"
	default "FT8719"
	depends on TOUCHSCREEN_FT8719

config TOUCHSCREEN_FT8719_DEBUG
	bool "Focaltech tp data dump"
	default n
	depends on TOUCHSCREEN_FT8719
```
